## Kconfig
```kconfig
# SPDX-License-Identifier: GPL-2.0
#
# For a description of the syntax of this configuration file,
# see Documentation/kbuild/kconfig-language.rst.
#
mainmenu "Linux/$(ARCH) $(KERNELVERSION) Kernel Configuration"

source "scripts/config.include"

source "init/config"

source "kernel/config.freezer"

source "fs/config.binfmt"

source "mm/config"

source "net/config"

source "drivers/config"

source "fs/config"

source "security/config"

source "crypto/config"

source "lib/config"

source "lib/config.debug"

source "Documentation/config"
```
